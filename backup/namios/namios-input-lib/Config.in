## backup/namios/namios-input-lib/Config.in
```kconfig
config BR2_PACKAGE_NAMIOS_INPUT_LIB
	bool "namios-input-lib"
	help
	  NAmiOS Input Library - touch input handling
```

## backup/namios_defconfig
```kconfig
# Architecture
BR2_aarch64=y
BR2_ARCH="aarch64"
BR2_ENDIAN="LITTLE"

# Toolchain
BR2_TOOLCHAIN_BUILDROOT_GLIBC=y

# System configuration
BR2_ROOTFS_DEVICE_CREATION_DYNAMIC_EUDEV=y

# Target packages
BR2_PACKAGE_BUSYBOX=y

# Graphic libraries
BR2_PACKAGE_LIBDRM=y

# NAmiOS components
BR2_PACKAGE_NAMIOS_GRAPHICS_LIB=y
BR2_PACKAGE_NAMIOS_INPUT_LIB=y
BR2_PACKAGE_NAMIOS_COMPOSITOR=y

# Filesystem overlay
BR2_ROOTFS_OVERLAY="../overlay"
```

## fs/buildroot/configs/namios_defconfig
```kconfig
# configs/namios_defconfig
BR2_aarch64=y
BR2_TOOLCHAIN_BUILDROOT_GLIBC=y
BR2_LINUX_KERNEL=n

# Filesystem
BR2_TARGET_ROOTFS_EXT2=y
BR2_TARGET_ROOTFS_EXT2_4=y
BR2_TARGET_ROOTFS_OVERLAY="overlay"


BR2_PACKAGE_LIBDRM=y
BR2_PACKAGE_LIBINPUT=y
BR2_PACKAGE_LIBEVDEV=y
BR2_PACKAGE_HAS_UDEV=y
BR2_PACKAGE_MTDEV=y
BR2_ROOTFS_DEVICE_CREATION_DYNAMIC_EUDEV=y
BR2_PACKAGE_EUDEV=y

# NAmiOS packages
BR2_PACKAGE_NAMIOS_GRAPHICS_LIB=y
BR2_PACKAGE_NAMIOS_INPUT_LIB=y
BR2_PACKAGE_NAMIOS_COMPOSITOR=y
```

## fs/buildroot/package/namios-compositor/Config.in
```kconfig
# package/namios/namios-compositor/Config.in
config BR2_PACKAGE_NAMIOS_COMPOSITOR
	bool "namios-compositor"
	depends on BR2_PACKAGE_NAMIOS_GRAPHICS_LIB
	depends on BR2_PACKAGE_NAMIOS_INPUT_LIB
	help
	  NAmiOS main compositor and window manager

comment "namios-compositor requires graphics and input libraries"
	depends on !BR2_PACKAGE_NAMIOS_GRAPHICS_LIB || !BR2_PACKAGE_NAMIOS_INPUT_LIB
```

## fs/buildroot/package/namios-graphics-lib/Config.in
```kconfig
# package/namios-graphics-lib/Config.in
config BR2_PACKAGE_NAMIOS_GRAPHICS_LIB
	bool "namios-graphics-lib"
	select BR2_PACKAGE_LIBDRM
	help
	  NAmiOS graphics library for framebuffer and DRM operations
```

## fs/buildroot/package/namios-input-lib/Config.in
```kconfig
# package/namios-input-lib/Config.in
config BR2_PACKAGE_NAMIOS_INPUT_LIB
	bool "namios-input-lib"
	select BR2_PACKAGE_LIBINPUT
	select BR2_PACKAGE_LIBEVDEV
	help
	  NAmiOS input library for touch and keyboard events
```

## fs/buildroot/package/namios/Config.in
```kconfig
menu "NAmiOS components"

source "package/namios/namios-graphics-lib/Config.in"
source "package/namios/namios-input-lib/Config.in"
source "package/namios/namios-compositor/Config.in"

endmenu
```

## fs/buildroot/package/namios/namios-compositor/Config.in
```kconfig
config BR2_PACKAGE_NAMIOS_COMPOSITOR
	bool "namios-compositor"
	depends on BR2_PACKAGE_NAMIOS_GRAPHICS_LIB
	depends on BR2_PACKAGE_NAMIOS_INPUT_LIB
	help
	  NAmiOS Mobile Compositor - graphical shell for NAmiOS
```

## fs/buildroot/package/namios/namios-graphics-lib/Config.in
```kconfig
config BR2_PACKAGE_NAMIOS_GRAPHICS_LIB
	bool "namios-graphics-lib"
	depends on BR2_PACKAGE_LIBDRM
	help
	  NAmiOS Graphics Library - low-level graphics abstraction
```
